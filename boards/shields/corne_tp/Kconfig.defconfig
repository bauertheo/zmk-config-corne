## boards/shields/corne_tp/Kconfig.defconfig
```kconfig
# The side that hosts the PS/2 TrackPoint MUST be the central side.
# ZMK defaults the LEFT side as central; we invert this so the right half
# (where the TP is wired) becomes central.

if SHIELD_CORNE_TP_RIGHT

config ZMK_KEYBOARD_NAME
    default "Corne TP"

config ZMK_SPLIT_ROLE_CENTRAL
    default y

endif

if SHIELD_CORNE_TP_LEFT || SHIELD_CORNE_TP_RIGHT

config ZMK_SPLIT
    default y

endif
```

## config/west.yml
```yaml
manifest:
  remotes:
    - name: infused-kim
      url-base: https://github.com/infused-kim
    - name: dhruvinsh
      url-base: https://github.com/dhruvinsh
  projects:
    # infused-kim's ZMK fork — the only one currently confirmed compatible with
    # the kb_zmk_ps2_mouse_trackpoint_driver module. Re-evaluate after the
    # upstream pointing-device PR merges.
    - name: zmk
      remote: infused-kim
      revision: pr-testing/mouse_ps2_module_base
      import: app/west.yml
    - name: kb_zmk_ps2_mouse_trackpoint_driver
      remote: infused-kim
      revision: main
    - name: zmk-tri-state
      remote: dhruvinsh
      # Pinned: later commits add `binding_event.source`, a field that does
      # not exist on the infused-kim/zmk@pr-testing/mouse_ps2_module_base
      # fork (zephyr v3.5.0+zmk-fixes, April 2024).
      revision: 9e44394
  self:
    path: config
```
