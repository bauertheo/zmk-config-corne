/*
 * TrackPoint helper macros and side-conditional devicetree overrides.
 * Adapted verbatim from the reference repo (kb_zmk_ps2_mouse_trackpoint_driver
 * zmk-config), with the keymap-side layer index kept as `MOUSE_TP` so the
 * keymap file controls which layer auto-activates on TP movement.
 *
 * Requires `MOUSE_TP` to be defined as the layer index before this file is
 * included.
 */

#ifdef HAS_MOUSE_TP
  #include <dt-bindings/zmk/mouse.h>
  #include <behaviors/mouse_keys.dtsi>

  #ifndef EXPERIMENT_NO_PS2
    #include <dt-bindings/zmk/mouse_settings.h>
    #include <behaviors/mouse_setting.dtsi>

    /* Runtime TP setting tweaks (saved to flash after CONFIG_ZMK_SETTINGS_SAVE_DEBOUNCE). */

    #define U_MSS_TP_S_I  &mms MS_TP_SENSITIVITY_INCR
    #define U_MSS_TP_S_D  &mms MS_TP_SENSITIVITY_DECR

    #define U_MSS_TP_V6_I &mms MS_TP_VALUE6_INCR
    #define U_MSS_TP_V6_D &mms MS_TP_VALUE6_DECR

    #define U_MSS_TP_NI_I &mms MS_TP_NEG_INERTIA_INCR
    #define U_MSS_TP_NI_D &mms MS_TP_NEG_INERTIA_DECR

    #define U_MSS_TP_PT_I &mms MS_TP_PTS_THRESHOLD_INCR
    #define U_MSS_TP_PT_D &mms MS_TP_PTS_THRESHOLD_DECR

    #define U_MSS_RESET   &mms MS_RESET
    #define U_MSS_LOG     &mms MS_LOG
  #else
    /* PS/2 stack disabled — driver isn't compiled, so &mms cannot resolve.
     * Stub the layer-6 macros to &none so the keymap still builds. */
    #define U_MSS_TP_S_I  &none
    #define U_MSS_TP_S_D  &none
    #define U_MSS_TP_V6_I &none
    #define U_MSS_TP_V6_D &none
    #define U_MSS_TP_NI_I &none
    #define U_MSS_TP_NI_D &none
    #define U_MSS_TP_PT_I &none
    #define U_MSS_TP_PT_D &none
    #define U_MSS_RESET   &none
    #define U_MSS_LOG     &none
  #endif


  /* Side-conditional config: only apply on the half that has the PS/2 nodes
   * (set by `#define MOUSE_PS2_DT_PRESENT` in corne_tp_right.overlay). */
  #if defined(MOUSE_PS2_DT_PRESENT) && !defined(EXPERIMENT_NO_PS2)

    &mouse_ps2_input_listener {
        layer-toggle = <MOUSE_TP>;
        layer-toggle-delay-ms = <250>;
        layer-toggle-timeout-ms = <250>;
        /* TP module is mounted with its native +Y axis pointing toward the
         * user; flip Y so cursor up means physical away. X is already
         * correct. */
        y-invert;
    };

    &mouse_ps2 {
        /* Tunable settings are intentionally left at defaults; tune at runtime
         * via MOUSE_TP_SET layer keys, then U_MSS_LOG dumps the values to USB
         * log. Copy them back here once a good config is found. */
    };

    &mouse_ps2 {
        status = "okay";
    };

    &mouse_ps2_input_listener {
        status = "okay";
    };

    #ifdef MOUSE_PS2_DRIVER_UART

      &uart0 {
          status = "okay";
      };

      &uart_ps2 {
          status = "okay";
      };

    #else

      &gpio_ps2 {
          status = "okay";
      };

    #endif

  #endif /* MOUSE_PS2_DT_PRESENT && !EXPERIMENT_NO_PS2 */

#endif /* HAS_MOUSE_TP */
